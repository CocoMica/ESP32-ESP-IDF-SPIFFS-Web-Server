## main/Kconfig.projbuild
```kconfig
menu "Example Configuration"

    config ESP_WIFI_SSID
        string "WiFi SSID"
        default "Jenny"
        help
            SSID (network name) for the example to connect to.

    config ESP_WIFI_PASSWORD
        string "WiFi Password"
        default "4168386922"
        help
            WiFi password (WPA or WPA2) for the example to use.

    config ESP_MAXIMUM_RETRY
        int "Maximum retry"
        default 5
        help
            Set the Maximum retry to avoid station reconnecting to the AP unlimited when the AP is really inexistent.

    config ESP_AP_SSID
        string "AP SSID"
        default "ESP"
        help
            AP SSID (network name) for the example to connect to.

    config ESP_AP_PASSWORD
        string "AP Password"
        default "123456789"
        help
            AP password (WPA or WPA2) for the example to use.
endmenu
```
